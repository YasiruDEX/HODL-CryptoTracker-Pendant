#include <Arduino.h>
#include "WiFiManager.h"
#include "FirebaseManager.h"
#include "HTTPManager.h"

#include <U8g2lib.h>
#include <ESP8266WebServer.h>
#include <ESP8266WiFi.h>

#ifdef U8X8_HAVE_HW_SPI
#include <SPI.h>
#endif
#ifdef U8X8_HAVE_HW_I2C
#include <Wire.h>
#endif

const char *ssid = "NodeMCU";
const char *password = "";

ESP8266WebServer server(80);

U8G2_SH1106_128X32_VISIONOX_F_HW_I2C u8g2(U8G2_R0, /* reset=*/U8X8_PIN_NONE);

String SSID = "UNITY";
String PASSWORD = "basnayake";
const char* referenceUrl = "hodlpendent-default-rtdb.firebaseio.com";
String httpUrl = "https://www.okx.com/api/v5/market/ticker?instId=ETH-USDT-SWAP";

FirebaseManager firebase(referenceUrl);
WiFiManager wifiManager(SSID, PASSWORD);
HTTPManager httpManager;

String Price = "none";
String previousPrice = "none";

String coin = "BTC";

bool up = false;
bool arrowdir = false;
bool WiFi_connected = true;
bool chart_mode = true;

String prevSSID = SSID;
String prevPASSWORD = PASSWORD;

int chart_values[10] = {03,04,02,-05,-02,05,01,-04,-07,02};
const int CHART_VALUES_SIZE = 10;
const int MAX_BARS = 10;

// Function declarations
void initialize();
void makeHttpRequest();
void handleRoot();
void handleUpdate();

unsigned long previousMillis = 0;
const long interval = 30000;  // 20 seconds

void u8g2_prepare(void) {
  u8g2.setFont(u8g2_font_6x10_tf);
  u8g2.setFontRefHeightExtendedText();
  u8g2.setDrawColor(1);
  u8g2.setFontPosTop();
  u8g2.setFontDirection(0);
}
void u8g2_string(uint8_t a) {

  u8g2.setFontDirection(3);
  // Convert Price to integer
  int priceInt = Price.toInt();

  u8g2.setFont(u8g2_font_6x10_tf);

  // Draw the integer value on the display
  u8g2.drawStr(68, 27, (String(int(priceInt - int(priceInt/1000)*1000 ))+"$").c_str());

  u8g2.setFont(u8g2_font_timB14_tf);
  u8g2.drawStr(53, 30, (String(priceInt/1000)+"K").c_str());

  u8g2.setFontDirection(0);

  if (coin == "BTC"){

  #define bitcoin_width 50
  #define bitcoin_height 32
  static const unsigned char bitcoin_bits[] U8X8_PROGMEM  = {
    0x00, 0x00, 0x00, 0x00, 0x00, 0x00, 0x00, 0x00, 0x00, 0x00, 0xfc, 0x03, 0x00, 0x00, 0x00, 0x00, 
  0x00, 0xfe, 0x07, 0x00, 0x00, 0x00, 0x80, 0x0f, 0xff, 0x0f, 0x00, 0x00, 0x00, 0xe0, 0x3f, 0xff, 
  0x1f, 0x00, 0x00, 0x00, 0xf0, 0xbf, 0xff, 0x3f, 0x00, 0x00, 0x00, 0xf0, 0xff, 0xff, 0x3f, 0x00, 
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  0x00, 0x00, 0x00, 0x3c, 0x00, 0x00, 0x78, 0x00, 0x00, 0x00, 0x00, 0x00, 0x00, 0x00, 0x00, 0x00, };
  u8g2.drawXBMP(0, 0, bitcoin_width, bitcoin_height, bitcoin_bits);
  u8g2.drawLine(48,0,48,32);
  
  }else if (coin == "ETH"){

  #define ethcoin_width 50
  #define ethcoin_height 32
  static const unsigned char ethcoin_bits[] U8X8_PROGMEM  = {
    0x00, 0x00, 0x00, 0x00, 0x00, 0x00, 0x00, 0x00, 0x00, 0x00, 0x00, 0x00, 0x00, 0x00, 0x00, 0x00, 
  0x80, 0x80, 0x00, 0x00, 0x00, 0x00, 0x00, 0xe0, 0x0e, 0x01, 0x00, 0x00, 0x00, 0x00, 0x70, 0x0e, 
  0x03, 0x00, 0x00, 0x00, 0x00, 0x3c, 0x1e, 0x0f, 0x00, 0x00, 0x00, 0x00, 0x3f, 0x1f, 0x1e, 0x00, 
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  0x00, 0x00, 0x00, 0x00, 0x80, 0x00, 0x00, 0x00, 0x00, 0x00, 0x00, 0x00, 0x00, 0x00, 0x00, 0x00, };
    u8g2.drawXBMP(0, 0, ethcoin_width, ethcoin_height, ethcoin_bits);

  }else{

    #define othcoin_width 50
  #define othcoin_height 32
  static const unsigned char othcoin_bits[] U8X8_PROGMEM  = {
      0x00, 0x00, 0x80, 0x00, 0x00, 0x00, 0x00, 0x00, 0x00, 0x80, 0x01, 0x00, 0x00, 0x00, 0x00, 0x00, 
  0x8c, 0x83, 0x00, 0x00, 0x00, 0x00, 0x00, 0x8f, 0x83, 0x03, 0x00, 0x00, 0x00, 0x80, 0x8f, 0x87, 
  0x07, 0x00, 0x00, 0x00, 0xc0, 0x8f, 0x87, 0x0f, 0x00, 0x00, 0x00, 0xe0, 0x8f, 0x87, 0x1f, 0x00, 
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  0x00, 0x00, 0x00, 0x00, 0xfe, 0xff, 0x03, 0x00, 0x00, 0x00, 0x00, 0xfc, 0xff, 0x00, 0x00, 0x00, };
    u8g2.drawXBMP(0, 0, othcoin_width, othcoin_height, othcoin_bits);
    u8g2.drawLine(48,0,48,32);
  
  }
  

  #define dollar_block_width 16
  #define dollar_block_height 16  

  static const unsigned char dollar_block_bits[] U8X8_PROGMEM  = {
    0xff, 0xff, 0xff, 0xff, 0xff, 0xff, 0xef, 0xf9, 0xc7, 0xf0, 0x47, 0xe0, 0x63, 0xe0, 0x70, 0x86, 
    0x31, 0x86, 0x03, 0xe3, 0x07, 0xe1, 0x8f, 0xf1, 0xff, 0xff, 0xff, 0xff, 0xff, 0xff, 0xff, 0xff};


  if(!chart_mode){
    if (up) {

      int top_arrow = 82;

      u8g2.drawTriangle(top_arrow - a + 5, 16, top_arrow + 20 - a, 2, top_arrow + 20 - a, 30);
      u8g2.drawBox(20 + top_arrow - a, 8, 20, 16);
      u8g2.drawXBMP(100-a, 8, dollar_block_width, dollar_block_height, dollar_block_bits); 

    } else {
      int down_arrow = 62;

      u8g2.drawTriangle(down_arrow + 55 + a, 16, down_arrow + 40 + a, 2, down_arrow + 40 + a, 30);
      u8g2.drawBox(20 + down_arrow + a, 8, 20, 16);
      u8g2.drawXBMP(85+a, 8, dollar_block_width, dollar_block_height, dollar_block_bits); 
    }
  }else{

    int middle_line = 100;

    //get the maximum value from chart_values array
    int max_val = chart_values[0];

    for (int i = 0; i < 10; i++) {
      if (chart_values[i] > max_val) {
        max_val = chart_values[i];
      }
    }

    int bar[MAX_BARS];
    int max_height = 20;

    //draw the chart
    // Calculate bar values using a loop
    for (int i = 0; i < MAX_BARS; ++i) {
        bar[i] = static_cast<int>((static_cast<float>(chart_values[i]) / max_val) * max_height);

        // Draw bars
        int y_position = 30 - i * 3;  // Adjust the y position based on the bar number
        if (bar[i] > 0) {
            u8g2.drawBox(middle_line - bar[i], y_position, bar[i], 2);
        } else {
            u8g2.drawBox(middle_line, y_position, -bar[i], 2);
        }
    }

    u8g2.drawLine(middle_line,0,middle_line,32);
  }


}

uint8_t draw_state = 0;

void setup() {
  u8g2.begin();
  Serial.begin(115200);
  Serial.println();
  Serial.println();
  Serial.println();
  initialize();
  makeHttpRequest();
  coin = firebase.getString("current_coin");
  Serial.println(coin);
  httpUrl = "https://www.okx.com/api/v5/market/ticker?instId=" + coin + "-USDT-SWAP";
}

void loop() {

  if(!wifiManager.isConnected()){

    if(WiFi_connected){

      // Connect to Wi-Fi
      WiFi.mode(WIFI_AP);
      WiFi.softAP(ssid, password);
      
      // Print the IP address
      Serial.println(WiFi.softAPIP());

      // Define webpage routes
      server.on("/", HTTP_GET, handleRoot);
      server.on("/update", HTTP_GET, handleUpdate);
      
      // Start server
      server.begin();
    }
    WiFi_connected = false;

    server.handleClient();

    Serial.print(SSID);
    Serial.print(" : ");
    Serial.println(PASSWORD);

    if (SSID != prevSSID or PASSWORD != prevPASSWORD){
      wifiManager.ssid = SSID;
      wifiManager.password = PASSWORD;
      initialize();
      WiFi_connected = true;
    }

    prevSSID = SSID;
    prevPASSWORD = PASSWORD;

  }else{
  
        httpUrl = "https://www.okx.com/api/v5/market/ticker?instId=" + coin + "-USDT-SWAP";

        unsigned long currentMillis = millis();

        int priceInt = Price.toInt();
        int previousPriceInt = previousPrice.toInt(); // Convert previousPrice to integer

        if (currentMillis - previousMillis >= interval) {
          previousMillis = currentMillis;
          previousPrice = Price;
          coin = firebase.getString("current_coin");
          Serial.println(coin);
          httpUrl = "https://www.okx.com/api/v5/market/ticker?instId=" + coin + "-USDT-SWAP";
          makeHttpRequest();
          if (Price.toInt() - previousPrice.toInt() < 30000) {
              // Shift values in the chart_values array
              for (int i = 0; i < CHART_VALUES_SIZE - 1; ++i) {
                  chart_values[i] = chart_values[i + 1];
              }

              // Set the last element to the difference of Price and previousPrice
              chart_values[CHART_VALUES_SIZE - 1] = Price.toInt() - previousPrice.toInt();
          }

          // Print the updated chart_values array
          Serial.print("Chart Values: ");
          for (int i = 0; i < CHART_VALUES_SIZE; ++i) {
              Serial.print(chart_values[i]);
              Serial.print(", ");
          }
          Serial.println();
        }



        // picture loop
        u8g2.clearBuffer();
        u8g2_prepare();
        u8g2_string(draw_state & 7);
        u8g2.sendBuffer();

        // increase the state
        draw_state++;

        if (draw_state >= 12 * 8){
          draw_state = 0;
          }

        // deley between each page
        delay(100);

        // Serial.print("Old Price: ");
        // Serial.print(previousPrice);
        // Serial.print(", New Price: ");
        // Serial.println(Price);

        if (priceInt > previousPriceInt) {
          up = true;
        } else if (priceInt < previousPriceInt) {
          up = false;
        }

        // Other non-blocking tasks can be performed here
  }
}

// Function definitions
void initialize() {
  wifiManager.connect();
}


void makeHttpRequest() {
  httpManager.fetchData(httpUrl, Price);
  Serial.println(Price);
}

void handleRoot() {
  String html = "<html><body>";
  html += "<h1>ESP8266 Webpage</h1>";
  html += "<p>SSID: " + String(SSID) + "</p>";
  html += "<p>PASSWORD: " + String(PASSWORD) + "</p>";
  html += "<form action='/update' method='get'>";
  html += "SSID: <input type='text' name='SSID'><br>";
  html += "PASSWORD: <input type='text' name='PASSWORD'><br>";
  html += "<input type='submit' value='Update'>";
  html += "</form>";
  html += "</body></html>";

  server.send(200, "text/html", html);
}

void handleUpdate() {
  if (server.hasArg("SSID")) {
    SSID = server.arg("SSID");
  }

  if (server.hasArg("PASSWORD")) {
    PASSWORD = server.arg("PASSWORD");
  }

  handleRoot();
}